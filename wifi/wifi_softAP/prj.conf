## CMakeLists.txt
```
cmake_minimum_required(VERSION 3.20.0)

find_package(Zephyr REQUIRED HINTS $ENV{ZEPHYR_BASE})
project(respeaker_wifi_softap)

target_sources(app PRIVATE src/main.c)
```

## Kconfig
```
# SPDX-License-Identifier: Apache-2.0

menu "reSpeaker Wi-Fi SoftAP sample"
endmenu

source "Kconfig.zephyr"

config RESPEAKER_WIFI_SOFTAP_SSID
	string "SoftAP SSID"
	default "reSpeaker-AP"
	help
	  SSID advertised by the SoftAP.

config RESPEAKER_WIFI_SOFTAP_PASSWORD
	string "SoftAP password (WPA2-PSK)"
	default ""
	help
	  Leave empty for an open network.

config RESPEAKER_WIFI_SOFTAP_BAND_5_GHZ
	bool "Use 5 GHz band (if supported)"
	default n
	help
	  Select 5 GHz. If disabled, 2.4 GHz is used.

config RESPEAKER_WIFI_SOFTAP_CHANNEL
	int "SoftAP channel"
	default 6
	range 1 165
	help
	  Wi-Fi channel. Valid range depends on the selected band and regulatory
	  domain. The sample also validates the band/channel at runtime.

config RESPEAKER_WIFI_SOFTAP_REG_DOMAIN
	string "Regulatory domain (2-letter country code)"
	default "US"
	help
	  Two-letter ISO country code used for Wi-Fi regulatory settings.
	  Example: US, CN, JP, DE.

config RESPEAKER_WIFI_SOFTAP_DHCPV4_POOL_START
	string "DHCPv4 pool start address"
	default "192.168.4.100"
	help
	  First IPv4 address to hand out via the DHCPv4 server.

config RESPEAKER_WIFI_SOFTAP_MAX_STATIONS
	int "Max stations tracked"
	default 8
	range 1 32
	help
	  Max number of connected stations tracked for logging/idle heuristics.

config RESPEAKER_WIFI_SOFTAP_AUTO_DISABLE_IDLE
	bool "Auto-disable SoftAP when idle"
	default y
	help
	  When enabled, the sample automatically disables the SoftAP if no
	  stations are connected for the configured idle timeout.

config RESPEAKER_WIFI_SOFTAP_IDLE_TIMEOUT_SEC
	int "Idle timeout (seconds)"
	default 300
	range 30 86400
	depends on RESPEAKER_WIFI_SOFTAP_AUTO_DISABLE_IDLE
	help
	  If no station is connected for this many seconds, the sample disables
	  SoftAP and stops the DHCP server.

config RESPEAKER_WIFI_SOFTAP_IDLE_CHECK_PERIOD_SEC
	int "Idle check period (seconds)"
	default 5
	range 1 3600
	depends on RESPEAKER_WIFI_SOFTAP_AUTO_DISABLE_IDLE
	help
	  How often the sample checks whether SoftAP has been idle.
```

## sysbuild.conf
```
# Enable nRF70 Wi-Fi when building with sysbuild (required for nrf7002dk)
SB_CONFIG_WIFI_NRF70=y
```

## prj.conf
```kconfig
# Wi-Fi + nRF70
CONFIG_WIFI=y
CONFIG_WIFI_NRF70=y

# WPA supplicant (AP mode support for nRF70)
CONFIG_WIFI_NM_WPA_SUPPLICANT=y
CONFIG_WIFI_NM_WPA_SUPPLICANT_AP=y

# Enable AP mode in driver
CONFIG_NRF70_AP_MODE=y

# Nordic helpers
CONFIG_WIFI_READY_LIB=y

# Networking
CONFIG_NETWORKING=y
CONFIG_NET_IPV4=y
CONFIG_NET_UDP=y
CONFIG_NET_TCP=y
CONFIG_NET_SOCKETS=y
CONFIG_NET_SOCKETS_POLL_MAX=10
CONFIG_NET_L2_ETHERNET=y

# Connection Manager (needed to bring up network interface)
CONFIG_NET_CONNECTION_MANAGER=y
#CONFIG_NET_CONNECTION_MANAGER_MONITOR=y

# DHCPv4 server (for SoftAP)
CONFIG_NET_DHCPV4_SERVER=y

# Static IPv4 for AP interface (used by app)
CONFIG_NET_CONFIG_SETTINGS=y
CONFIG_NET_CONFIG_MY_IPV4_ADDR="192.168.4.1"
CONFIG_NET_CONFIG_MY_IPV4_NETMASK="255.255.255.0"
CONFIG_NET_CONFIG_MY_IPV4_GW="192.168.4.1"
CONFIG_NET_CONFIG_INIT_TIMEOUT=0

# Net buffers (tuned modestly; adjust if you see drops)
CONFIG_NET_PKT_RX_COUNT=8
CONFIG_NET_PKT_TX_COUNT=8
CONFIG_NET_BUF_RX_COUNT=8
CONFIG_NET_BUF_TX_COUNT=16
CONFIG_NET_TC_TX_COUNT=1
CONFIG_NET_IF_UNICAST_IPV4_ADDR_COUNT=1

# nRF70 heaps (often required for stable operation)
CONFIG_NRF_WIFI_CTRL_HEAP_SIZE=20000
CONFIG_NRF_WIFI_DATA_HEAP_SIZE=53000
CONFIG_NRF70_RX_NUM_BUFS=16

# Kernel/Logging
CONFIG_MAIN_STACK_SIZE=4096
CONFIG_INIT_STACKS=y
CONFIG_ENTROPY_GENERATOR=y
CONFIG_LOG=y
CONFIG_LOG_BUFFER_SIZE=2048
CONFIG_LOG_DEFAULT_LEVEL=3

# Net mgmt events can be slow in crowded environments
CONFIG_NET_MGMT_EVENT_QUEUE_TIMEOUT=5000

# (Optional) make build/link happy if some subsystems pull FS
CONFIG_FILE_SYSTEM=y
```

## src/main.c
```c
#include <errno.h>
#include <string.h>

#include <zephyr/kernel.h>
#include <zephyr/logging/log.h>

#include <zephyr/net/net_if.h>
#include <zephyr/net/net_mgmt.h>
#include <zephyr/net/wifi_mgmt.h>
#include <zephyr/net/wifi_utils.h>
#include <zephyr/net/dhcpv4_server.h>

#include <zephyr/sys/util.h>
#include <zephyr/sys/printk.h>

#include <net/wifi_ready.h>

LOG_MODULE_REGISTER(respeaker_wifi_softap, CONFIG_LOG_DEFAULT_LEVEL);

#define WIFI_AP_MGMT_EVENTS                                                                    \
	(NET_EVENT_WIFI_AP_ENABLE_RESULT | NET_EVENT_WIFI_AP_DISABLE_RESULT |                    \
	 NET_EVENT_WIFI_AP_STA_CONNECTED | NET_EVENT_WIFI_AP_STA_DISCONNECTED)

static struct net_mgmt_event_callback wifi_ap_mgmt_cb;
static K_SEM_DEFINE(wifi_ready_sem, 0, 1);
static bool wifi_ready;

static K_MUTEX_DEFINE(sta_list_lock);

struct sta_node {
	bool valid;
	struct wifi_ap_sta_info info;
};

static struct sta_node sta_list[CONFIG_RESPEAKER_WIFI_SOFTAP_MAX_STATIONS];

static struct net_if *wifi_iface;
static int64_t last_activity_ms;
static bool ap_running;

#if IS_ENABLED(CONFIG_RESPEAKER_WIFI_SOFTAP_AUTO_DISABLE_IDLE)
static void idle_power_mgr_work_fn(struct k_work *work);
static K_WORK_DELAYABLE_DEFINE(idle_power_mgr_work, idle_power_mgr_work_fn);
#endif

static int sta_count_unlocked(void)
{
	int count = 0;

	for (int i = 0; i < ARRAY_SIZE(sta_list); i++) {
		if (sta_list[i].valid) {
			count++;
		}
	}

	return count;
}

static void note_activity(void)
{
	last_activity_ms = k_uptime_get();
}

static const char *mac_to_str(const uint8_t *mac, char *buf, size_t buf_len)
{
	if (!mac || !buf || buf_len < sizeof("xx:xx:xx:xx:xx:xx")) {
		return "(invalid)";
	}

	snprintk(buf, buf_len, "%02x:%02x:%02x:%02x:%02x:%02x",
		 mac[0], mac[1], mac[2], mac[3], mac[4], mac[5]);
	return buf;
}

static void print_sta_list_unlocked(void)
{
	size_t id = 1;

	LOG_INF("AP stations:");
	LOG_INF("============");

	for (int i = 0; i < ARRAY_SIZE(sta_list); i++) {
		if (!sta_list[i].valid) {
			continue;
		}

		char mac_buf[sizeof("xx:xx:xx:xx:xx:xx")];
		LOG_INF("Station %zu MAC: %s", id++, mac_to_str(sta_list[i].info.mac, mac_buf, sizeof(mac_buf)));
	}

	if (id == 1) {
		LOG_INF("No stations connected");
	}
}

static void on_wifi_ready(bool ready)
{
	wifi_ready = ready;
	k_sem_give(&wifi_ready_sem);
}

static void handle_ap_enable_result(struct net_mgmt_event_callback *cb)
{
	const struct wifi_status *status = (const struct wifi_status *)cb->info;

	if (status && status->status) {
		LOG_ERR("AP enable failed (%d)", status->status);
		return;
	}

	LOG_INF("AP enable requested");
	ap_running = true;
	note_activity();
}

static void handle_ap_disable_result(struct net_mgmt_event_callback *cb)
{
	const struct wifi_status *status = (const struct wifi_status *)cb->info;

	if (status && status->status) {
		LOG_ERR("AP disable failed (%d)", status->status);
		return;
	}

	LOG_INF("AP disable requested");
	ap_running = false;
	note_activity();
}

static void handle_sta_connected(struct net_mgmt_event_callback *cb)
{
	const struct wifi_ap_sta_info *sta = (const struct wifi_ap_sta_info *)cb->info;
	char mac_buf[sizeof("xx:xx:xx:xx:xx:xx")];

	LOG_INF("Station connected: %s", mac_to_str(sta->mac, mac_buf, sizeof(mac_buf)));
	note_activity();

	k_mutex_lock(&sta_list_lock, K_FOREVER);
	for (int i = 0; i < ARRAY_SIZE(sta_list); i++) {
		if (!sta_list[i].valid) {
			sta_list[i].info = *sta;
			sta_list[i].valid = true;
			break;
		}
	}
	print_sta_list_unlocked();
	k_mutex_unlock(&sta_list_lock);
}

static void handle_sta_disconnected(struct net_mgmt_event_callback *cb)
{
	const struct wifi_ap_sta_info *sta = (const struct wifi_ap_sta_info *)cb->info;
	char mac_buf[sizeof("xx:xx:xx:xx:xx:xx")];

	LOG_INF("Station disconnected: %s", mac_to_str(sta->mac, mac_buf, sizeof(mac_buf)));
	note_activity();

	k_mutex_lock(&sta_list_lock, K_FOREVER);
	for (int i = 0; i < ARRAY_SIZE(sta_list); i++) {
		if (!sta_list[i].valid) {
			continue;
		}

		if (memcmp(sta_list[i].info.mac, sta->mac, WIFI_MAC_ADDR_LEN) == 0) {
			sta_list[i].valid = false;
			break;
		}
	}
	print_sta_list_unlocked();
	k_mutex_unlock(&sta_list_lock);
}

static void wifi_mgmt_event_handler(struct net_mgmt_event_callback *cb,
				   uint64_t mgmt_event, struct net_if *iface)
{
	ARG_UNUSED(iface);

	switch (mgmt_event) {
	case NET_EVENT_WIFI_AP_ENABLE_RESULT:
		handle_ap_enable_result(cb);
		break;
	case NET_EVENT_WIFI_AP_DISABLE_RESULT:
		handle_ap_disable_result(cb);
		break;
	case NET_EVENT_WIFI_AP_STA_CONNECTED:
		handle_sta_connected(cb);
		break;
	case NET_EVENT_WIFI_AP_STA_DISCONNECTED:
		handle_sta_disconnected(cb);
		break;
	default:
		break;
	}
}

static int set_reg_domain(struct net_if *iface)
{
	struct wifi_reg_domain regd = { 0 };

	regd.oper = WIFI_MGMT_SET;
	strncpy(regd.country_code, CONFIG_RESPEAKER_WIFI_SOFTAP_REG_DOMAIN, WIFI_COUNTRY_CODE_LEN);
	regd.country_code[WIFI_COUNTRY_CODE_LEN] = '\0';

	int ret = net_mgmt(NET_REQUEST_WIFI_REG_DOMAIN, iface, &regd, sizeof(regd));
	if (ret) {
		LOG_WRN("Failed to set regulatory domain (%d)", ret);
		return ret;
	}

	LOG_INF("Regulatory domain set to %s", CONFIG_RESPEAKER_WIFI_SOFTAP_REG_DOMAIN);
	return 0;
}

static int start_dhcp_server(struct net_if *iface)
{
	struct in_addr pool_start;

	if (net_addr_pton(AF_INET, CONFIG_RESPEAKER_WIFI_SOFTAP_DHCPV4_POOL_START,
			 &pool_start.s_addr)) {
		LOG_ERR("Invalid DHCP pool start: %s", CONFIG_RESPEAKER_WIFI_SOFTAP_DHCPV4_POOL_START);
		return -EINVAL;
	}

	int ret = net_dhcpv4_server_start(iface, &pool_start);
	if (ret == -EALREADY) {
		LOG_WRN("DHCPv4 server already running");
		return 0;
	}
	if (ret < 0) {
		LOG_ERR("DHCPv4 server start failed: %d", ret);
		return ret;
	}

	LOG_INF("DHCPv4 server started, pool from %s", CONFIG_RESPEAKER_WIFI_SOFTAP_DHCPV4_POOL_START);
	return 0;
}

static void stop_dhcp_server(struct net_if *iface)
{
	int ret = net_dhcpv4_server_stop(iface);
	if (ret == -EALREADY) {
		return;
	}
	if (ret < 0) {
		LOG_WRN("DHCPv4 server stop failed: %d", ret);
	}
}

static int disable_softap(struct net_if *iface)
{
	int ret = net_mgmt(NET_REQUEST_WIFI_AP_DISABLE, iface, NULL, 0);
	if (ret) {
		LOG_WRN("NET_REQUEST_WIFI_AP_DISABLE failed: %d", ret);
	} else {
		LOG_INF("AP disable requested (idle power save)");
	}

	stop_dhcp_server(iface);
	net_if_down(iface);
	ap_running = false;
	return ret;
}

#if IS_ENABLED(CONFIG_RESPEAKER_WIFI_SOFTAP_AUTO_DISABLE_IDLE)
static void idle_power_mgr_work_fn(struct k_work *work)
{
	ARG_UNUSED(work);

	if (!wifi_iface) {
		return;
	}

	if (!ap_running) {
		return;
	}

	int connected = 0;
	k_mutex_lock(&sta_list_lock, K_FOREVER);
	connected = sta_count_unlocked();
	k_mutex_unlock(&sta_list_lock);

	if (connected == 0) {
		int64_t idle_ms = k_uptime_get() - last_activity_ms;
		if (idle_ms >= (int64_t)CONFIG_RESPEAKER_WIFI_SOFTAP_IDLE_TIMEOUT_SEC * 1000) {
			LOG_INF("No stations for %d sec, disabling SoftAP to save power",
				CONFIG_RESPEAKER_WIFI_SOFTAP_IDLE_TIMEOUT_SEC);
			(void)disable_softap(wifi_iface);
			return;
		}
	}

	k_work_schedule(&idle_power_mgr_work, K_SECONDS(CONFIG_RESPEAKER_WIFI_SOFTAP_IDLE_CHECK_PERIOD_SEC));
}
#endif

static int configure_ap_ipv4(struct net_if *iface)
{
	struct in_addr addr = { 0 };
	struct in_addr netmask = { 0 };
	struct in_addr gw = { 0 };

	if (net_addr_pton(AF_INET, CONFIG_NET_CONFIG_MY_IPV4_ADDR, &addr)) {
		LOG_ERR("Invalid CONFIG_NET_CONFIG_MY_IPV4_ADDR: %s", CONFIG_NET_CONFIG_MY_IPV4_ADDR);
		return -EINVAL;
	}

	if (net_addr_pton(AF_INET, CONFIG_NET_CONFIG_MY_IPV4_NETMASK, &netmask)) {
		LOG_ERR("Invalid CONFIG_NET_CONFIG_MY_IPV4_NETMASK: %s", CONFIG_NET_CONFIG_MY_IPV4_NETMASK);
		return -EINVAL;
	}

	if (net_addr_pton(AF_INET, CONFIG_NET_CONFIG_MY_IPV4_GW, &gw)) {
		LOG_ERR("Invalid CONFIG_NET_CONFIG_MY_IPV4_GW: %s", CONFIG_NET_CONFIG_MY_IPV4_GW);
		return -EINVAL;
	}

	net_if_ipv4_set_gw(iface, &gw);

	if (net_if_ipv4_addr_add(iface, &addr, NET_ADDR_MANUAL, 0) == NULL) {
		LOG_WRN("IPv4 address add failed (may already be set)");
	}

	if (!net_if_ipv4_set_netmask_by_addr(iface, &addr, &netmask)) {
		LOG_WRN("Unable to set netmask for AP interface: %s", CONFIG_NET_CONFIG_MY_IPV4_NETMASK);
	}

	LOG_INF("AP IPv4 configured: %s", CONFIG_NET_CONFIG_MY_IPV4_ADDR);
	return 0;
}

static int enable_softap(struct net_if *iface)
{
	static struct wifi_connect_req_params ap = { 0 };

#ifdef CONFIG_RESPEAKER_WIFI_SOFTAP_BAND_5_GHZ
	ap.band = WIFI_FREQ_BAND_5_GHZ;
#else
	ap.band = WIFI_FREQ_BAND_2_4_GHZ;
#endif
	ap.channel = CONFIG_RESPEAKER_WIFI_SOFTAP_CHANNEL;

	ap.ssid = (const uint8_t *)CONFIG_RESPEAKER_WIFI_SOFTAP_SSID;
	ap.ssid_length = strlen((const char *)ap.ssid);
	if (ap.ssid_length > WIFI_SSID_MAX_LEN) {
		LOG_ERR("SSID too long (%u)", ap.ssid_length);
		return -EINVAL;
	}

	if (!wifi_utils_validate_chan(ap.band, ap.channel)) {
		LOG_ERR("Invalid channel %u in band %u", ap.channel, ap.band);
		return -EINVAL;
	}

	if (strlen(CONFIG_RESPEAKER_WIFI_SOFTAP_PASSWORD) == 0) {
		ap.security = WIFI_SECURITY_TYPE_NONE;
		ap.psk = NULL;
		ap.psk_length = 0;
		LOG_INF("Starting open SoftAP: %s", CONFIG_RESPEAKER_WIFI_SOFTAP_SSID);
	} else {
		ap.security = WIFI_SECURITY_TYPE_PSK;
		ap.psk = (const uint8_t *)CONFIG_RESPEAKER_WIFI_SOFTAP_PASSWORD;
		ap.psk_length = strlen((const char *)ap.psk);
		LOG_INF("Starting WPA2-PSK SoftAP: %s", CONFIG_RESPEAKER_WIFI_SOFTAP_SSID);
	}

	int ret = net_mgmt(NET_REQUEST_WIFI_AP_ENABLE, iface, &ap, sizeof(ap));
	if (ret) {
		LOG_ERR("NET_REQUEST_WIFI_AP_ENABLE failed: %d", ret);
		return ret;
	}

	return 0;
}

int main(void)
{
	int ret;

	LOG_INF("reSpeaker Wi-Fi SoftAP sample starting");

	struct net_if *iface = NULL;

	/* Some configs expose a dedicated SAP iface; otherwise fall back to first Wi-Fi iface. */
	for (int i = 0; i < 50; i++) {
		iface = net_if_get_wifi_sap();
		if (!iface) {
			iface = net_if_get_first_wifi();
		}
		if (iface) {
			break;
		}
		k_sleep(K_MSEC(100));
	}

	if (!iface) {
		LOG_ERR("No Wi-Fi interface found (net_if_get_wifi_sap/first_wifi returned NULL)");
		LOG_ERR("This usually means the image was built without the Wi-Fi driver or for the wrong board.");
		LOG_ERR("Check Kconfig: CONFIG_WIFI=%d CONFIG_WIFI_NRF70=%d CONFIG_NRF70_AP_MODE=%d",
			IS_ENABLED(CONFIG_WIFI), IS_ENABLED(CONFIG_WIFI_NRF70), IS_ENABLED(CONFIG_NRF70_AP_MODE));
		LOG_ERR("Fix: rebuild for nrf7002dk/nrf5340/cpuapp and ensure prj.conf enables Wi-Fi, then flash the new image.");
		return -ENODEV;
	}
	LOG_INF("WiFi interface found");

	wifi_ready_callback_t ready_cb = {
		.wifi_ready_cb = on_wifi_ready,
		.iface = iface,
	};

	ret = register_wifi_ready_callback(ready_cb, iface);
	if (ret) {
		LOG_WRN("register_wifi_ready_callback failed: %d", ret);
	}

	net_mgmt_init_event_callback(&wifi_ap_mgmt_cb, wifi_mgmt_event_handler, WIFI_AP_MGMT_EVENTS);
	net_mgmt_add_event_callback(&wifi_ap_mgmt_cb);

	/* Wait until Wi-Fi is reported ready (or timeout to continue anyway). */
	(void)k_sem_take(&wifi_ready_sem, K_SECONDS(10));
	LOG_INF("Wi-Fi ready: %s", wifi_ready ? "yes" : "no/timeout");

	(void)set_reg_domain(iface);
	(void)configure_ap_ipv4(iface);
	(void)start_dhcp_server(iface);

	ret = enable_softap(iface);
	if (ret) {
		LOG_ERR("SoftAP enable failed: %d", ret);
	}

	wifi_iface = iface;
	ap_running = (ret == 0);
	note_activity();

#if IS_ENABLED(CONFIG_RESPEAKER_WIFI_SOFTAP_AUTO_DISABLE_IDLE)
	k_work_schedule(&idle_power_mgr_work, K_SECONDS(CONFIG_RESPEAKER_WIFI_SOFTAP_IDLE_CHECK_PERIOD_SEC));
#endif

	while (1) {
		k_sleep(K_SECONDS(5));
	}
}
```
