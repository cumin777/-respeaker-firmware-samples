## driver/custom_driver_module/drivers/Kconfig
```kconfig
menu "Drivers"
rsource "display/Kconfig"
rsource "input/Kconfig"
rsource "storage/Kconfig"
endmenu
```

## driver/custom_driver_module/drivers/display/custom_OLED_Display_128X64/Kconfig
```kconfig
config CUSTOM_OLED_DISPLAY_128X64
	bool "Custom CH1115 OLED display driver"
	default y
	depends on DT_HAS_SOLOMON_CH1115_ENABLED
	select I2C
	select DISPLAY
	help
	  Enable a custom CH1115-based OLED display driver.
	  Note: despite the symbol name, this project targets an 88x48 I2C OLED.
```

## driver/custom_driver_module/drivers/input/Kconfig
```kconfig
menuconfig CUSTOM_GPIO_BUTTON_GESTURE
	bool "Custom GPIO button gesture driver"
	default y
	depends on DT_HAS_RESPEAKER_GPIO_BUTTON_GESTURE_ENABLED
	select GPIO
	help
	  Provides a GPIO-backed button gesture device (single/double/long).
```

## driver/custom_driver_module/drivers/storage/Kconfig
```kconfig
# Custom Storage Drivers
#
# Copyright (c) 2024, Custom Driver Module
# SPDX-License-Identifier: Apache-2.0

menu "Custom Storage Drivers"

rsource "custom_sd_spi_sdmmc/Kconfig"

endmenu
```

## driver/custom_driver_module/drivers/storage/custom_sd_spi_sdmmc/Kconfig
```kconfig
# Custom SD SPI SDMMC Driver
#
# Copyright (c) 2024, Custom Driver Module
# SPDX-License-Identifier: Apache-2.0

config CUSTOM_SD_SPI_SDMMC
	bool "Custom SD/MMC Card driver over SPI"
	default y
	depends on DT_HAS_ZEPHYR_CUSTOM_SD_SPI_SDMMC_ENABLED
	select SPI
	select DISK_ACCESS
	select DISK_DRIVER_SDMMC
	select RING_BUFFER
	help
	  Enable a custom SD/MMC Card driver that uses SPI interface.

	  This driver supports standard SD 2.0 protocol and can be used
	  with SDHC cards up to 32GB capacity.

	  The driver is designed for low-power embedded applications like
	  audio recording devices where SD card is used for persistent storage.

config CUSTOM_SD_SPI_SDMMC_SPI_CLK_FREQ
	int "SPI clock frequency in Hz"
	default 25000000
	depends on CUSTOM_SD_SPI_SDMMC
	help
	  SPI clock frequency for SD card communication.

	  Standard SD cards support up to 25MHz in SPI mode.
	  Lower frequencies can be used for power optimization.

config CUSTOM_SD_SPI_SDMMC_SPI_CLK_FREQ_INIT
	int "SPI initialization clock frequency in Hz"
	default 400000
	depends on CUSTOM_SD_SPI_SDMMC
	help
	  SPI clock frequency used during SD card initialization.

	  SD cards require low clock frequency (<400kHz) during
	  initialization sequence.

config CUSTOM_SD_SPI_SDMMC_USE_DMA
	bool "Use DMA for data transfers"
	default y
	depends on CUSTOM_SD_SPI_SDMMC && SPI_NRFX
	help
	  Enable DMA support for SD card data transfers.

	  Using DMA reduces CPU overhead and improves power efficiency.
```

## driver/custom_driver_module/dts/bindings/display/solomon,ch1115.yaml
```yaml
# 文件: c:/ncs/v3.2.1/l7_e1/custom_driver_module/dts/bindings/display/solomon,ch1115.yaml

description: Solomon CH1115 compatible OLED display

compatible: "solomon,ch1115"

include: i2c-device.yaml

properties:
  width:
    type: int
    required: true
    description: Width in pixels of the display

  height:
    type: int
    required: true
    description: Height in pixels of the display

  segment-offset:
    type: int
    default: 0
    description: Offset of the first segment from the left

  page-offset:
    type: int
    default: 0
    description: Offset of the first page from the top

  display-offset:
    type: int
    default: 0
    description: Display offset

  multiplex-ratio:
    type: int
    default: 63
    description: Multiplex ratio

  segment-remap:
    type: int
    default: 0
    description: Segment remap

  com-invdir:
    type: int
    default: 0
    description: COM output scan direction

  prechargep:
    type: int
    default: 0x22
    description: Pre-charge period

  reset-gpios:
    type: compound
    required: false
    description: Reset GPIO pin
```

## driver/custom_driver_module/dts/bindings/input/respeaker,gpio-button-gesture.yaml
```yaml
description: Respeaker GPIO button gesture detector

compatible: "respeaker,gpio-button-gesture"

include: base.yaml

properties:
  gpios:
    type: phandle-array
    required: true
    description: Button GPIO.

  debounce-ms:
    type: int
    default: 20
    description: Debounce delay after an edge interrupt.

  tap-threshold-ms:
    type: int
    default: 300
    description: Max press duration to be treated as a tap candidate (else single on release).

  double-click-ms:
    type: int
    default: 600
    description: Max time between two taps (release-to-release) to be treated as a double click.

  long-press-ms:
    type: int
    default: 1000
    description: Press-and-hold duration to emit a long press.
```

## driver/custom_driver_module/dts/bindings/storage/zephyr,custom-sd-spi-sdmmc.yaml
```yaml
# Custom SD SPI SDMMC Driver Device Tree Binding
#
# Copyright (c) 2024, Custom Driver Module
# SPDX-License-Identifier: Apache-2.0

description: |
  Custom SD/MMC Card driver over SPI interface.
  Supports standard SD 2.0 protocol with SPI mode communication.
  Compatible with SDHC cards up to 32GB capacity.

compatible: "zephyr,custom-sd-spi-sdmmc"

include: [spi-device.yaml, base.yaml]

properties:
  reg:
    required: true

  spi-max-frequency:
    type: int
    required: true
    description: |
      Maximum SPI clock frequency in Hz.
      Standard SD cards support up to 25MHz in SPI mode.

  cs-gpios:
    type: phandle-array
    description: |
      Chip select GPIO.

  cd-gpios:
    type: phandle-array
    description: |
      Card detect GPIO. Active low when card is present.

  wp-gpios:
    type: phandle-array
    description: |
      Write protect GPIO.

  power-gpios:
    type: phandle-array
    description: |
      Power enable GPIO for controlling SD card power supply.
      Useful for low-power applications to disable SD card when not in use.

  mmc-hs200-1_8v:
    type: boolean
    description: |
      Enable high speed mode.

  no-mmc:
    type: boolean
    default: true
    description: |
      Disable MMC card support.

  no-sdio:
    type: boolean
    default: true
    description: |
      Disable SDIO mode support.

  max-block-count:
    type: int
    default: 32767
    description: |
      Maximum number of blocks in a single read/write operation.

child-binding:
  description: |
    SD card node may have a child node for partition information.
```
